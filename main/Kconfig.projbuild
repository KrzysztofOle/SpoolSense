## main/Kconfig.projbuild
```kconfig
menu "SpoolSense configuration"

config SPOOLSENSE_ENABLE_HX711
    bool "Enable HX711 subsystem"
    default y
    help
        Enable the HX711 task and related measurement flow.
        When disabled, the firmware runs in RFID/UI developer mode.

config SPOOLSENSE_IGNORE_MISSING_PN532
    bool "Ignore missing PN532"
    default y
    help
        Treat a missing PN532 reader as an idle RFID subsystem instead of an error.

config SPOOLSENSE_IGNORE_MISSING_HX711
    bool "Ignore missing HX711"
    default y
    help
        Treat a missing HX711 scale as a disabled subsystem instead of an error.

endmenu
```

## sdkconfig.defaults
```kconfig
CONFIG_AUTOSTART_ARDUINO=n
CONFIG_IDF_TARGET="esp32"
CONFIG_ESP_CONSOLE_UART_DEFAULT=y
CONFIG_ESP_CONSOLE_UART_BAUDRATE=115200
CONFIG_ESPTOOLPY_FLASHSIZE_16MB=y
CONFIG_FREERTOS_HZ=1000
CONFIG_SPOOLSENSE_ENABLE_HX711=y
CONFIG_SPOOLSENSE_IGNORE_MISSING_PN532=y
CONFIG_SPOOLSENSE_IGNORE_MISSING_HX711=y
CONFIG_LV_FONT_MONTSERRAT_20=y
CONFIG_LV_FONT_MONTSERRAT_22=y
```
